## config/boards/shields/flounderV2/Kconfig.defconfig
```kconfig
if SHIELD_FLOUNDERV2_LEFT
 
config ZMK_KEYBOARD_NAME
    default "flounderV2"
 
config ZMK_SPLIT_ROLE_CENTRAL
    default y
 
endif
 
if SHIELD_FLOUNDERV2_LEFT || SHIELD_FLOUNDERV2_RIGHT
 
config ZMK_SPLIT
    default y
 
endif
```

## config/boards/shields/flounderV2/Kconfig.shield
```kconfig
config SHIELD_FLOUNDERV2_LEFT
    def_bool $(shields_list_contains,flounderV2_left)
    select SHIELD_FLOUNDERV2

config SHIELD_FLOUNDERV2_RIGHT
    def_bool $(shields_list_contains,flounderV2_right)
    select SHIELD_FLOUNDERV2
```
